## meta-openstlinux-custom/conf/layer.conf
```bitbake
# We have a conf and classes directory, add to BBPATH
BBPATH .= ":${LAYERDIR}"

# We have recipes-* directories, add to BBFILES
BBFILES += "${LAYERDIR}/recipes-*/*/*.bb \
            ${LAYERDIR}/recipes-*/*/*.bbappend"

BBFILE_COLLECTIONS += "meta-openstlinux-custom"
BBFILE_PATTERN_meta-openstlinux-custom = "^${LAYERDIR}/"
BBFILE_PRIORITY_meta-openstlinux-custom = "6"

LAYERDEPENDS_meta-openstlinux-custom = "core"
LAYERSERIES_COMPAT_meta-openstlinux-custom = "scarthgap"
```
